// SPDX-License-Identifier: BSD-3-Clause
/*
 * Copyright (c) 2016-2022, AngeloGioacchino Del Regno
 *                          <angelogioacchino.delregno@collabora.com>
 * Copyright (c) 2022, Konrad Dybcio <konrad.dybcio@somainline.org>
 * Copyright (c) 2022, Marijn Suijten <marijn.suijten@somainline.org>
 */

#include "msm8976.dtsi"

&pmu_a72 {
	interrupts = <GIC_PPI 7 (GIC_CPU_MASK_RAW(0x30) | IRQ_TYPE_LEVEL_HIGH)>;
};

&tsens {
	compatible = "qcom,msm8956-tsens", "qcom,tsens-v1";
};

/*
 * MSM8956 only features 2 Cortex-A72 cores (cpu4 and cpu5).
 * cpu6 and cpu7 do not exist on this SoC.
 */
&cpu6 {
	status = "disabled";
};

&cpu5 {
	status = "disabled";
};
